// Description: Overlay to enable the secondary memory interface peripheral
// Author:      Luke Wren

/dts-v1/;
/plugin/;

/{
        compatible = "brcm,bcm2835";

        fragment@0 {
                target = <&smi>;
                __overlay__ {
                        pinctrl-names = "default";
                        pinctrl-0 = <&smi_pins>;
                        status = "okay";
                };
        };

        fragment@1 {
                target = <&gpio>;
                __overlay__ {
                        smi_pins: smi_pins {
                                /* Don't configure the top two address bits, as
                                   these are already used as ID_SD and ID_SC */
                                brcm,pins = <16 17 18 19 21 22 23>;
                                /* Alt 1: SMI */
                                brcm,function = <5 5 5 5 5 5 5>;
                                /* /CS, /WE and /OE are pulled high, as they are
                                   generally active low signals */
                                brcm,pull = <1 1 1 1 1 1 1>;
                        };
                };
        };
};


